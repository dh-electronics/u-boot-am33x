## configs/am335x_dhcom_nand_defconfig
```kconfig
CONFIG_ARM=y
CONFIG_TARGET_AM335X_DHCOM=y
CONFIG_SPL=y
CONFIG_SPL_STACK_R=y
CONFIG_SPL_STACK_R_ADDR=0x82000000
CONFIG_SYS_EXTRA_OPTIONS="CONS_INDEX=1,SPI_BOOT,NAND"
# CONFIG_CMD_IMLS is not set
# CONFIG_CMD_FLASH is not set
# CONFIG_CMD_SETEXPR is not set
CONFIG_CMD_GPIO=y
CONFIG_CONS_INDEX=1
CONFIG_SYS_MALLOC_CLEAR_ON_INIT=n
CONFIG_SPI_FLASH=y
CONFIG_SPI_FLASH_SPANSION=y
CONFIG_SYS_NS16550=y
```
